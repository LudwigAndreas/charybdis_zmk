## config/west.yml
```yaml
manifest:
  remotes:
    - name: zmkfirmware
      url-base: https://github.com/zmkfirmware

    - name: 280Zo
      url-base: https://github.com/280Zo

    - name: badjeff
      url-base: https://github.com/badjeff

  projects:
    - name: zmk
      remote: zmkfirmware
      # revision: main
      revision: cb786cd
      import: app/west.yml

    - name: zmk-pmw3610-driver
      remote: badjeff 
      # revision: main
      revision: a1a0f35

  self:
    path: config
```
